## src/modules/lqr_controller/Kconfig
```kconfig
menuconfig MODULES_LQR_CONTROLLER
	bool "lqr_controller"
	default n
	---help---
		Enable support for lqr_controller
```

## src/modules/omni_amrac_aback/Kconfig
```kconfig
menuconfig MODULES_OMNI_AMRAC_ABACK
	bool "omni_amrac_aback"
	default n
	---help---
		Enable support for omni_amrac_aback
```

## src/modules/omni_amrac_amrac/Kconfig
```kconfig
menuconfig MODULES_OMNI_AMRAC_AMRAC
	bool "omni_amrac_amrac"
	default n
	---help---
		Enable support for omni_amrac_amrac
```

## src/modules/omni_amrac_pifl/Kconfig
```kconfig
menuconfig MODULES_OMNI_AMRAC_PIFL
	bool "omni_amrac_pifl"
	default n
	---help---
		Enable support for omni_amrac_pifl
```

## src/modules/omni_pid_aback/Kconfig
```kconfig
menuconfig MODULES_OMNI_PID_ABACK
	bool "omni_pid_aback"
	default n
	---help---
		Enable support for omni_pid_aback
```

## src/modules/omnicopter_controller/Kconfig
```kconfig
menuconfig MODULES_OMNICOPTER_CONTROLLER
	bool "omnicopter_controller"
	default n
	---help---
		Enable support for omnicopter_controller
```
